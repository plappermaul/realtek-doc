## sources/uboot-gp3000/board/realtek_10G_PON/common/Kconfig
```kconfig
config SYS_VENDOR
	default "realtek_10G_PON"

config NR_DRAM_BANKS
	default 3

config DISPLAY_BOARDINFO
	default n

config CMD_LOADB
	default y

config CMD_SAVEENV
	default y

config BOOTDELAY
	default 3

config CMDLINE_EDITING
	default y

config CORTINA_UART
	bool
	default y

config MTD_CORTINA_SERIAL_NOR
	tristate "Serial NOR Flash device mapped on Cortina SoC Platforms"
	help
		Map driver for CORTINA reference board.

config CORTINA_SERIAL_NAND
	tristate "Serial NAND Flash device mapped on Cortina SoC Platforms"
	help
		Map driver for CORTINA reference board.

config CORTINA_SPINAND_BBT
	bool "MTD: SPINAND Bad Block Table(For linux-4.4)"
	depends on CORTINA_SERIAL_NAND
	default y if !TARGET_RTK_ELNATH
	help
		MTD NAND Bad Block Table

config CORTINA_PNAND
	tristate "NAND Flash device on Cortina-Access board"
	help
		This enables the driver for the Cortina board to access the nand device.

config CORTINA_PNAND_ECC_LEVEL
	int "Cortina-Access Nand driver HW ecc level"
	default 3
	range 0 5
	depends on CORTINA_PNAND
	help
		NAND Flash ECC algorithm. Value range is from 0 to 5. The default value is 3.

		0: Hamming algorithm. Correct 3 bad bits in 256 btyes.
		1: Hamming algorithm. Correct 3 bad bits in 512 btyes.
		2: BCH algorithm. Correct 8 bad bits in 512 btyes.
		3: BCH algorithm. Correct 16 bad bits in 512 btyes.
		4: BCH algorithm. Correct 24 bad bits in 512 btyes.
		5: BCH algorithm. Correct 40 bad bits in 512 btyes.

config CORTINA_PNAND_ECC_HW_BCH
     bool
     default y
     depends on CORTINA_PNAND_ECC_LEVEL=2 \
             || CORTINA_PNAND_ECC_LEVEL=3 \
             || CORTINA_PNAND_ECC_LEVEL=4 \
             || CORTINA_PNAND_ECC_LEVEL=5

config NAND_HIDE_BAD
    bool "Hide NAND flash factory bad block"
    help
        Bad block are hidden and flash space is remapped as a continue good space.

config CONS_INDEX_0
	default y

config UART_CLOCK
	int

config NI_PHY_ADDR_GMAC0
	int
	default 1

config NI_PHY_ADDR_GMAC1
	int
	default 2

config NI_PHY_ADDR_GMAC2
	int
	default 3


config G3_NAND_ECC_HW_BCH_LEVEL
	int

config G3_NAND_HWECC
	bool

config NAND_G3
	bool

menuconfig REALTEK_10G_PON
	bool "RealTek Luna support"

if REALTEK_10G_PON
config RTK_V7_FPGA_PLATFORM
	bool "Venus/Taurus/Elnath V7 FPGA BOARD"
	default n
	 help
	 For Venus/Trurus/Elnath V7 FPGA Development.

config RTK_V8_FPGA_PLATFORM
	bool "Elnath V8 FPGA BOARD"
	default n
	help
	For Elnath V8 FPGA Development.

config RTK_ZEBU_SIM
	bool "Elnath ZEBU simulation"
	default n
	help
        For Elnath ZEBU simulation use

config RTK_USE_ONE_UBI_DEVICE
	bool "RTK use single UBI device"
	depends on CMD_UBI
	help
		Use single UBI device for config/DTB/kernel/rootfs/...

config LUNA_MULTI_BOOT
	bool "LUNA MULTI BOOT"
	default n
	help
		Luna multi-boot
config RTK_LED_STYLE_GPIO
	bool "RTK LED System Use GPIO"
	default n
	help
	RTK Demo Board use GPIO to control LED.

config ENV_CALLBACK_LIST_STATIC
	string
	default "pwr_led_flash:pwr_led_flash,pwr_led_gpio:pwr_led_gpio"
	depends on RTK_LED_STYLE_GPIO
	help
	Env variable "pwr_led_flash" can influence PWR LED behavior
	pwr_led_flash : 1 , Always on
	pwr_led_flash : 300 . Every 300ms , switch once.

config RTK_PWR_BOOT_ON
	bool "RTK LED System: PWR_LED ON on booting "
	depends on  RTK_LED_STYLE_GPIO
	help
	PWR_LED always on when uboot bring up.

config EARLY_PWR_LED_INIT
	bool "RTK LED System: Initialize power led before env setup"
	default n
	depends on  RTK_LED_STYLE_GPIO
	help
	Enable EARLY_PWR_LED_INIT to use default LED_PWR_G_GPIO defined in rtk_gpio_led.c,
	and blink the LED before env setup.

	Say Y here only if LED_PWR_G_GPIO has been modified to meet the board design since
	it's unable to get the gpio saved in env.

config MULTICAST_UPGRADE
	bool "RTK Luna MULTICAST_UPGRADE"
	select LUNA_MULTI_BOOT
	help
		Multicast upgrade firmware.

config CMD_OTP
    bool "Secure OTP access command"
    default n
    help
        OTP content access through SMC call.

config CMD_CRYPTO
    bool "Secure Encryption/Decryption command"
    default n
    help
        Secure Encryption/Decryption command.
        
config CMD_SPI_NAND_TEST_FUNC
    bool "Enable SPI NAND flash test function"
    default n
    help
        Enable the SPI NAND relative test command for in-house verification. 

config CMD_SPI_NOR_TEST_FUNC
    bool "Enable SPI NOR flash test function"
    default n
    help
        Enable the SPI NOR relative test command for in-house verification.       

config TARGET_RTK_VENUS_FT
        bool "RTK VENUS FT BOARD"
        default n
        help
                For RTK VENUS FT Development.

config BL_IMAGE_INC_OPTEED
        bool "RTK BL image contains OPTEE(Bl32) Image"
        default n
        help
                Bootloader image contains OPTEE(Bl32) image for TEE

config CMD_SOC_TEST
        bool "support CN2/3 SOC cmd test"
        default n
        help
          utilities and options you want.

config CMD_RTK_LDMA_TEST
        bool "support RTK LDMA cmd test"
        depends on CMD_SOC_TEST
        help
          realtek LDMA test cmd

config CMD_RTK_XRAM_TEST
        bool "support RTK XRAM cmd test"
        depends on CMD_SOC_TEST
        help
          realtek XRAM test cmd

config CMD_RTK_I2S
        bool "support RTK I2S cmd test"
        depends on CMD_SOC_TEST
        help
          realtek i2s test cmd

config CMD_RTK_SPI
        bool "support DW SSI test"
        depends on CMD_SOC_TEST
        help
          BJ4

config CMD_RTK_GDMA
        bool "support DW GDMA test"
        depends on CMD_SOC_TEST
        help
          BJ4

config CMD_CA_RTC
        bool "support CA RTC(Real Time Clock)"
        depends on CMD_SOC_TEST
        help
          BJ4

config CMD_RTK_CRYPTO
        bool "support RTK CRYPTO cmd test"
        depends on CMD_SOC_TEST
        help
          realtek crypto test cmd

config CMD_RTK_UART
        bool "support RTK UART_DMA cmd test"
        depends on CMD_SOC_TEST
        help
          realtek UART_DMA test cmd

config CMD_RTK_SD30
        bool "support RTK SD30 cmd test"
        depends on CMD_SOC_TEST
        help
          BJ4

config CMD_RTK_EMMC
        bool "support RTK EMMC cmd test"
        depends on CMD_SOC_TEST
        help
          BJ4

config CMD_RTK_PER_TMR_TEST
        bool "support RTK PER_TMR/PER_SYS_TMR cmd test"
        depends on CMD_SOC_TEST
        help
          realtek PER_TMR/PER_SYS_TMR test cmd


endif
```

## sources/uboot-gp3000/board/realtek_10G_PON/elnath/Kconfig
```kconfig
if TARGET_RTK_ELNATH

config SYS_SOC
	default "elnath"

config CA8277B
	bool
	default y

config SYS_BOARD
	default "elnath"

config SYS_CONFIG_NAME
	default "elnath"

config SYS_TEXT_BASE
	default "0x04000000"

config IDENT_STRING
	default "ELNATH-SoC" if ARM64
	default "ELNATH-SoC-AARCH32" if !ARM64

config BOOTP_VCI_STRING
	default "U-boot.armv8.elnath"
	default "U-boot.armv7.elnath" if !ARM64

config SYS_PROMPT
	default "Elnath# "

config SYS_BOOTM_LEN
	hex
	default 0x1000000

endif
```

## sources/uboot-gp3000/board/realtek_10G_PON/presidio-asic/Kconfig
```kconfig
if TARGET_PRESIDIO_ASIC

source "board/realtek_10G_PON/common/Kconfig"

config SYS_SOC
	default "presidio"

config CA77XX
	bool
	default y

config SYS_BOARD
	default "presidio-asic"

config SYS_CONFIG_NAME
	default "presidio_asic"

config SYS_TEXT_BASE
	default "0x04000000"

config IDENT_STRING
	default "Presidio-SoC"

config BOOTP_VCI_STRING
	default "U-boot.armv8.presidio"

config SYS_PROMPT
	default "G3# "

endif
```

## sources/uboot-gp3000/board/realtek_10G_PON/taurus/Kconfig
```kconfig
if TARGET_RTK_TAURUS

config SYS_SOC
	default "taurus"

config CA8277B
	bool
	default y

config SYS_BOARD
	default "taurus"

config SYS_CONFIG_NAME
	default "taurus"

config SYS_TEXT_BASE
	default "0x04000000"

config IDENT_STRING
	default "Taurus-SoC" if ARM64
	default "Taurus-SoC(OPTEE)" if (ARM64 && BL_IMAGE_INC_OPTEED)
	default "Taurus-SoC-AARCH32" if !ARM64

config BOOTP_VCI_STRING
	default "U-boot.armv8.taurus"
	default "U-boot.armv7.taurus" if !ARM64

config SYS_PROMPT
	default "TAURUS# "

config SYS_BOOTM_LEN
	hex "bootm size"
	default 0x1800000

config RTK_TAURUS_HW_TEST
    bool "Enable RTK TAURUS hardware test function"
    default n
    help
        For RTK TAURUS in-house test only

endif
```

## sources/uboot-gp3000/board/realtek_10G_PON/venus/Kconfig
```kconfig
if TARGET_VENUS

config SYS_SOC
	default "venus"

config CA8277B
	bool
	default y

config SYS_BOARD
	default "venus"

config SYS_CONFIG_NAME
	default "venus"

config SYS_TEXT_BASE
	default "0x04000000"

config IDENT_STRING
	default "Venus-SoC" if ARM64
	default "Venus-SoC-AARCH32" if !ARM64

config BOOTP_VCI_STRING
	default "U-boot.armv8.venus" if ARM64
	default "U-boot.armv7.venus" if !ARM64

config SYS_PROMPT
	default "VENUS# "

config SYS_BOOTM_LEN
	hex "bootm size"
	default 0x1800000

config ARCH_CORTINA_SMC
    bool "SMC for Cortina AARCH64"
    default n
    help
        This enables support for Cortina private SMC call


config RTK_VENUS_CPUFREQ_CMD
    bool "VENUS CPU Frequency Command"
    default n
    help
        This enables support for CPU Frequency Command

config PARALLEL_LED_EXTENSION
    bool "Control PWR_LED by VENUS parallel LED"
    default n
    depends on RTK_LED_STYLE_GPIO
    help
	    Use parallel LED to take over PWR_LED blinking

endif
```

## sources/uboot-gp3000/configs/Phoebus_spi_nand_demo_mtd_default_defconfig
```kconfig
CONFIG_OTTO=y
CONFIG_ENV_SIZE=0x4000
CONFIG_SYS_REDUNDAND_ENVIRONMENT=y
CONFIG_SYS_LONGHELP=y
CONFIG_ENV_OFFSET=0xC0000
CONFIG_ENV_OFFSET_REDUND=0xE0000
CONFIG_NR_DRAM_BANKS=2
CONFIG_TARGET_PHOEBUS=y
CONFIG_BOARD_LATE_INIT=y
CONFIG_DISPLAY_BOARDINFO=y
CONFIG_AUTO_COMPLETE=y
CONFIG_SYS_PROMPT="Phoebus# "
CONFIG_HUSH_PARSER=y
# CONFIG_BOOTM_NETBSD is not set
# CONFIG_BOOTM_PLAN9 is not set
# CONFIG_BOOTM_RTEMS is not set
# CONFIG_BOOTM_VXWORKS is not set
# CONFIG_CMD_XIMG is not set
# CONFIG_CMD_UBI=y
# CONFIG_CMD_UBIFS=y
# CONFIG_PARTITIONS is not set

#
# Flash Type
#
CONFIG_OTTO_SNAF=y
CONFIG_OTTO_SNAF_GEN=3
CONFIG_OTTO_ECC_GEN=2

# ENV
CONFIG_CMD_SAVEENV=y
CONFIG_ENV_IS_IN_NAND=y
CONFIG_USE_DEFAULT_ENV_FILE=y
CONFIG_DEFAULT_ENV_FILE="./board/realtek/Phoebus_demo/UBOOT-2020-SNAF-DEFAULT_ENV_FILE"

# MTD
CONFIG_CMD_MTD=y
CONFIG_CMD_MTDPARTS=y # depends CONFIG_DM=y
CONFIG_DM=y
CONFIG_MTD=y
CONFIG_MTD_RAW_NAND=y
# CONFIG_RAM_ROCKCHIP_DEBUG is not set
CONFIG_SYS_NS16550=y
CONFIG_LZMA=y

# RTK SPECIFIC SETTING
CONFIG_OTTO_FL_TO_MTDPARTS=y
CONFIG_OTTO_FLASH_LAYOUT=y
#CONFIG_RTK_USE_ONE_UBI_DEVICE=y
CONFIG_USE_BBT_SKIP=y
CONFIG_LUNA_MULTI_BOOT=y
CONFIG_MULTICAST_UPGRADE=y
CONFIG_STATIC_CONFIG=y
```

## sources/uboot-gp3000/configs/rtk-multi-boot_rtl8277c-spinand_19c_defconfig
```kconfig
CONFIG_ARM=y
CONFIG_TARGET_RTK_TAURUS=y
CONFIG_ENV_SIZE=0x40000
CONFIG_ENV_OFFSET=0x280000
CONFIG_DISPLAY_BOARDINFO=y
CONFIG_CORTINA_SERIAL_NAND=y
CONFIG_NAND_HIDE_BAD=y
CONFIG_REALTEK_10G_PON=y
CONFIG_RTK_USE_ONE_UBI_DEVICE=y
CONFIG_LUNA_MULTI_BOOT=y
CONFIG_RTK_LED_STYLE_GPIO=y
CONFIG_CMD_OTP=y
# CONFIG_SYS_MALLOC_F is not set
CONFIG_FIT=y
CONFIG_FIT_VERBOSE=y
CONFIG_FIT_BEST_MATCH=y
# CONFIG_DISPLAY_CPUINFO is not set
CONFIG_LAST_STAGE_INIT=y
CONFIG_HUSH_PARSER=y
CONFIG_CMD_MTD=y
CONFIG_CMD_NAND=y
CONFIG_CMD_PCI=y
# CONFIG_NET_TFTP_VARS is not set
# CONFIG_CMD_NFS is not set
CONFIG_CMD_PING=y
CONFIG_CMD_CACHE=y
CONFIG_CMD_TIMER=y
CONFIG_CMD_FAT=y
CONFIG_CMD_MTDPARTS=y
CONFIG_MTDIDS_DEFAULT="ca_spinand_flash"
CONFIG_CMD_UBI=y
CONFIG_MTD_UBI_FASTMAP=y
CONFIG_MTD_UBI_FASTMAP_AUTOCONVERT=1
# CONFIG_PARTITIONS is not set
CONFIG_OF_CONTROL=y
CONFIG_DEFAULT_DEVICE_TREE="rtk-taurus"
CONFIG_ENV_IS_IN_NAND=y
CONFIG_SYS_REDUNDAND_ENVIRONMENT=y
CONFIG_ENV_OFFSET_REDUND=0x2C0000
CONFIG_USE_DEFAULT_ENV_FILE=y
CONFIG_DEFAULT_ENV_FILE="../u-boot-env/UBOOT-2018-DEFAULT_ENV_FILE"
CONFIG_DM=y
CONFIG_BLK=y
CONFIG_DM_GPIO=y
CONFIG_CORTINA_GPIO=y
# CONFIG_MMC is not set
CONFIG_MTD=y
CONFIG_MTD_RAW_NAND=y
CONFIG_MII=y
CONFIG_NVME=y
CONFIG_PCI=y
CONFIG_DM_PCI=y
CONFIG_DM_PCI_COMPAT=y
CONFIG_PCIE_DW_RTK_TAURUS=y
CONFIG_RTK_WATCHDOG=y
# CONFIG_REGEX is not set
CONFIG_LZO=y
# CONFIG_EFI_LOADER is not set
```

## sources/uboot-gp3000/configs/rtl8198de_spi_nor_demo_defconfig
```kconfig
CONFIG_OTTO=y
CONFIG_TARGET_PHOEBUS=y
CONFIG_SYS_LONGHELP=y
CONFIG_ENV_OFFSET=0x40000
CONFIG_ENV_OFFSET_REDUND=0x42000
CONFIG_ENV_SIZE=0x2000
CONFIG_ENV_SECT_SIZE=0x2000
CONFIG_SYS_REDUNDAND_ENVIRONMENT=y
CONFIG_NR_DRAM_BANKS=2
CONFIG_BOARD_LATE_INIT=y
CONFIG_DISPLAY_BOARDINFO=y
CONFIG_AUTO_COMPLETE=y
CONFIG_SYS_PROMPT="Phoebus# "
CONFIG_HUSH_PARSER=y

#
# Flash Type
#
CONFIG_OTTO_SNOF=y


# ENV
CONFIG_CMD_SAVEENV=y
CONFIG_ENV_IS_IN_SPI_FLASH=y
CONFIG_ENV_ADDR=0x94100000

CONFIG_USE_DEFAULT_ENV_FILE=y
CONFIG_DEFAULT_ENV_FILE="./board/realtek/Phoebus_demo/UBOOT-2020-NOR-DEFAULT_ENV_FILE"

# MTD
CONFIG_DM=y
CONFIG_SPI=y

CONFIG_SYS_NS16550=y
CONFIG_LZMA=y

# RTK SPECIFIC SETTING
CONFIG_OTTO_FLASH_LAYOUT=y
#CONFIG_RTK_USE_ONE_UBI_DEVICE=y
CONFIG_LUNA_MULTI_BOOT=y
CONFIG_MULTICAST_UPGRADE=y
CONFIG_STATIC_CONFIG=y
```

## sources/uboot-gp3000/configs/rtl9310_nand_demo_defconfig
```kconfig
CONFIG_OTTO=y
CONFIG_ENV_SIZE=0x8000
CONFIG_ENV_OFFSET=0x100000
CONFIG_NR_DRAM_BANKS=2
# CONFIG_MIPS_BOOT_CMDLINE_LEGACY is not set
# CONFIG_MIPS_BOOT_ENV_LEGACY is not set
CONFIG_TARGET_RTL9310=y
CONFIG_OTTO_SNAF=y
CONFIG_BOARD_LATE_INIT=y
CONFIG_DISPLAY_BOARDINFO=y
CONFIG_HUSH_PARSER=y
CONFIG_SYS_PROMPT="RTL9310# "
# CONFIG_CMD_FLASH is not set
CONFIG_CMD_MTD=y
CONFIG_CMD_MTDPARTS=y
CONFIG_ENV_IS_IN_NAND=y
CONFIG_DM=y
CONFIG_MTD=y
CONFIG_MTD_RAW_NAND=y
CONFIG_SYS_NS16550=y
CONFIG_CMD_DHRYSTONE=y
# CONFIG_NET is not set
```

## sources/uboot-gp3000/configs/rtl9310_nor_demo_defconfig
```kconfig
CONFIG_OTTO=y
CONFIG_ENV_SIZE=0x8000
CONFIG_ENV_OFFSET=0x100000
CONFIG_NR_DRAM_BANKS=2
CONFIG_ENV_SECT_SIZE=0x8000
# CONFIG_MIPS_BOOT_CMDLINE_LEGACY is not set
# CONFIG_MIPS_BOOT_ENV_LEGACY is not set
CONFIG_TARGET_RTL9310=y
CONFIG_OTTO_SNOF=y
CONFIG_DISPLAY_BOARDINFO=y
CONFIG_SYS_PROMPT="RTL9310# "
# CONFIG_CMD_IMI is not set
# CONFIG_CMD_XIMG is not set
# CONFIG_CMD_CRC32 is not set
# CONFIG_PARTITIONS is not set
CONFIG_ENV_IS_IN_SPI_FLASH=y
CONFIG_ENV_ADDR=0x94100000
# CONFIG_NET is not set
CONFIG_DM=y
CONFIG_SYS_NS16550=y
CONFIG_SPI=y
```

## sources/uboot-gp3000/configs/rtl9603cvd_spi_nor_demo_defconfig
```kconfig
CONFIG_OTTO=y
CONFIG_OTTO_SNOF=y
CONFIG_TARGET_RTL9603CVD=y
CONFIG_ENV_OFFSET=0x40000
CONFIG_ENV_OFFSET_REDUND=0x42000
CONFIG_ENV_SIZE=0x2000
CONFIG_ENV_SECT_SIZE=0x2000
CONFIG_SYS_REDUNDAND_ENVIRONMENT=y
CONFIG_NR_DRAM_BANKS=2

CONFIG_DISPLAY_BOARDINFO=y
CONFIG_SYS_PROMPT="RTK# "
CONFIG_HUSH_PARSER=y

CONFIG_ENV_IS_IN_SPI_FLASH=y
CONFIG_ENV_ADDR=0x94100000
CONFIG_USE_DEFAULT_ENV_FILE=y
CONFIG_DEFAULT_ENV_FILE="./board/realtek/rtl9603cvd_spi_nor_demo/UBOOT-2020-DEFAULT_ENV_FILE"
CONFIG_DM=y
CONFIG_SYS_NS16550=y
CONFIG_SPI=y
# RTK SPECIFIC SETTING
CONFIG_OTTO_FLASH_LAYOUT=y
CONFIG_LUNA_MULTI_BOOT=y
CONFIG_MULTICAST_UPGRADE=y
CONFIG_STATIC_CONFIG=y

CONFIG_LZMA=y
```
